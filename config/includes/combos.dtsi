    / {

    
        combos {
            combo_dvorak {
                bindings = <&tog DVORAK>; // Dvorak Layer
                key-positions = <K56 K64>;
            };
        };

        


    };